## app/boards/arm/my_rpi5_board/Kconfig.my_rpi5_board
```kconfig
# Copyright 2024 Junho Lee <junho@tsnlab.com>
# SPDX-License-Identifier: Apache-2.0

config BOARD_MY_RPI5_BOARD
	bool "My Raspberry Pi 5 Board"
	select SOC_BCM2712
```

## app/boards/arm/my_rpi5_board/board.yml
```yaml
board:
  name: my_rpi5_board 
  full_name: Raspberry Pi 5 (Cortex-A76)
  vendor: raspberrypi
  socs:
  - name: bcm2712
```

## app/boards/arm/my_scratch_board/Kconfig.my_scratch_board
```kconfig
config BOARD_MY_SCRATCH_BOARD
	bool "My Scratch Board (RPi5)"
	select SOC_BCM2712
```

## app/boards/arm/my_scratch_board/board.yml
```yaml
board:
  name: my_scratch_board 
  full_name: my scratch Raspberry Pi 5 (Cortex-A76)
  vendor: raspberrypi
  socs:
  - name: bcm2712
```

## app/boards/arm/my_scratch_board/my_scratch_board_defconfig
```kconfig
CONFIG_BOARD_MY_SCRATCH_BOARD=y
CONFIG_SERIAL=y
CONFIG_CONSOLE=y
CONFIG_PRINTK=y
```

## app/drivers/led_sensor/Kconfig
```kconfig
menuconfig MY_LED_SENSOR
    bool "My LED Sensor Driver"
    depends on GPIO
    help
      Simple LED-based sensor driver.
      sample_fetch() turns the LED ON.
      channel_get()  turns the LED OFF and returns a dummy value.

if MY_LED_SENSOR

config MY_LED_SENSOR_INIT_PRIORITY
    int "Init priority"
    default 80

endif
```
